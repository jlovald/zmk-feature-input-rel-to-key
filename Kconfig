## Kconfig
```kconfig
config ZMK_INPUT_REL_TO_KEY
    bool "Relative movement to key input processor"
    default y
    help
      Convert relative pointer movement (X/Y) into configurable key presses.
      Sends a key press whenever accumulated relative motion crosses the configured threshold.
```

## dts/bindings/zmk,input-processor-rel-to-key.yaml
```yaml
description: Convert relative pointer movement into configurable key presses

compatible: "zmk,input-processor-rel-to-key"

properties:
  x-positive-keycode:
    type: int
    required: true
    description: Keycode sent when relative X motion exceeds positive threshold
  x-negative-keycode:
    type: int
    required: true
    description: Keycode sent when relative X motion exceeds negative threshold
  y-positive-keycode:
    type: int
    required: true
    description: Keycode sent when relative Y motion exceeds positive threshold
  y-negative-keycode:
    type: int
    required: true
    description: Keycode sent when relative Y motion exceeds negative threshold
  x-threshold:
    type: int
    required: true
    description: Accumulated X motion needed to trigger a key press
  y-threshold:
    type: int
    required: true
    description: Accumulated Y motion needed to trigger a key press
```

## dts/bindings/zmk,input-processor-xy-mapper.yaml
```yaml
description: Convert relative pointer movement into configurable key presses

compatible: "zmk,input-processor-xy-mapper"

properties:
  key-pos-x:
    type: int
    required: true
    description: Keycode sent when X is positive
  key-neg-x:
    type: int
    required: true
    description: Keycode sent when X is negative
  key-pos-y:
    type: int
    required: true
    description: Keycode sent when Y is positive
  key-neg-y:
    type: int
    required: true
    description: Keycode sent when Y is negative
  threshold:
    type: int
    required: true
    description: Accumulation threshold for sending a key event
  invert-x:
    type: bool
    required: false
    description: Invert the X axis (swap positive/negative key)
  invert-y:
    type: bool
    required: false
    description: Invert the Y axis (swap positive/negative key)
```

## west.yml
```yaml
manifest:
  remotes:
    - name: zmk-feature-input-rel-to-key
      url-base: https://github.com/jlovald
  projects:
    # Together with the above defined remote, this refers to a module located at
    # https://github.com/remote-name/repository-name
    - name: zmk-feature-input-rel-to-key
      remote: jlovald
      # This points to a west manifest file in the remote module for further imports
      import: west.yml
```
